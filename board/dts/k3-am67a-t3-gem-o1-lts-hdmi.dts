// SPDX-License-Identifier: GPL-2.0-only OR MIT
/*
 * T3 Gemstone O1 with HDMI on the 6.18 LTS kernel + HDMI patches (kernels/lts-hdmi, docs/BELGE.md §27).
 * Built as k3-am67a-t3-gem-o1.dtb (the name U-Boot loads).
 */

/dts-v1/;

#include "k3-am67a-t3-gem-o1-common.dtsi"
#include "k3-am67a-t3-gem-o1-display.dtsi"
#include "k3-am67a-t3-gem-o1-gpu-v7.4.dtsi"
