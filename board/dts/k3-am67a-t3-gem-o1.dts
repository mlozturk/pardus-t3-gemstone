// SPDX-License-Identifier: GPL-2.0-only OR MIT
/* T3 Gemstone O1 with HDMI: Debian kernel + HDMI patches (docs/BELGE.md Â§21). */

/dts-v1/;

#include "k3-am67a-t3-gem-o1-common.dtsi"
#include "k3-am67a-t3-gem-o1-display.dtsi"
